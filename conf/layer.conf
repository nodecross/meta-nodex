## conf/layer.conf
```bitbake
# We have a conf and classes directory, add to BBPATH
BBPATH .= ":${LAYERDIR}"

# We have recipes-* directories, add to BBFILES
BBFILES += "${LAYERDIR}/recipes-*/*/*.bb \
            ${LAYERDIR}/recipes-*/*/*.bbappend"

BBFILE_COLLECTIONS += "meta-nodex"
BBFILE_PATTERN_meta-nodex = "^${LAYERDIR}/"
BBFILE_PRIORITY_meta-nodex = "6"

LAYERDEPENDS_meta-nodex = "core"
LAYERSERIES_COMPAT_meta-nodex = "kirkstone"

PREFERRED_VERSION_rust-bin-cross-${TARGET_ARCH} = "1.78.0"
PREFERRED_VERSION_cargo-bin-cross-${TARGET_ARCH} = "${PREFERRED_VERSION_rust-bin-cross-${TARGET_ARCH}}"
```
